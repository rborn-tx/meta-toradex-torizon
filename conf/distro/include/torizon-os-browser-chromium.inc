## conf/distro/include/torizon-os-browser-chromium.inc
```bitbake
# Chromium base additions
IMAGE_FEATURES += "weston"
CORE_IMAGE_EXTRA_INSTALL += "chromium-ozone-wayland weston weston-init weston-examples"
```

## conf/distro/include/torizon-os-chromium.inc
```bitbake
# Chromium base additions
CORE_IMAGE_EXTRA_INSTALL += "chromium-ozone-wayland weston weston-init weston-examples"
LICENSE_FLAGS_ACCEPTED += "commercial_libav commercial_x264"
DISTRO_FEATURES += "wayland vulkan opengl seccomp"
DISTRO_FEATURES_TORIZON_REMOVE:remove = "alsa wayland x11 opengl vulkan"
IMAGE_FEATURES += "weston"
DISTRO_FEATURES_NATIVE_TORIZON_REMOVE:remove = "x11"
DISTRO_FEATURES_NATIVESDK_TORIZON_REMOVE:remove = "x11"
```

## conf/distro/include/torizon-os-nonostree.inc
```bitbake
# For swupdate, Rauc and Mender
EXTRA_IMAGE_FEATURES += "read-only-rootfs read-only-rootfs-delayed-postinsts"
DISTRO_FEATURES:remove = " sota "
INITRAMFS_IMAGE:forcevariable = ""
IMAGE_FSTYPES:remove = " ostreepush garagesign garagecheck "
BBMASK:append = " \
    /meta-updater \
    /meta-toradex-torizon/recipes-bsp/u-boot/ \
    /meta-openembedded/meta-oe/recipes-extended/ostree \
"
CORE_IMAGE_BASE_INSTALL:remove = " \
    ostree-customize-plymouth \
    ostree-devicetree-overlays \
"
IMAGE_CLASSES:remove = "image_type_torizon image_types_ostree image_types_ota"
IMAGE_CLASSES_TORIZON_REMOVE:remove = "image_type_tezi"
```

## conf/distro/include/torizon-os-updater-benchmarking.inc
```bitbake
EXTRA_IMAGE_FEATURES += "debug-tweaks"
IMAGE_ROOTFS_SIZE = "1048576"
CORE_IMAGE_BASE_INSTALL:remove = "usermount"
IMAGE_INSTALL:append = " os-release udev-extraconf "

# These settings are explicitly only needed for chromium
# but to make sure all builds use the same settings will
# will apply them here.
LICENSE_FLAGS_ACCEPTED += "commercial_libav commercial_x264"
DISTRO_FEATURES += "wayland vulkan opengl seccomp"
DISTRO_FEATURES_TORIZON_REMOVE:remove = "alsa wayland x11 opengl vulkan"
DISTRO_FEATURES_NATIVE_TORIZON_REMOVE:remove = "x11"
DISTRO_FEATURES_NATIVESDK_TORIZON_REMOVE:remove = "x11"

# Note: BENCHMARK_INCLUDED_* variables are defined in bblayers.conf.
require conf/distro/include/torizon-os-browser-${BENCHMARK_INCLUDED_BROWSER}.inc
require conf/distro/include/torizon-os-updater-${BENCHMARK_INCLUDED_UPDATER}.inc
```

## conf/distro/include/torizon-os-updater-mender.inc
```bitbake
require conf/distro/include/torizon-os-nonostree.inc
inherit mender-full
inherit mender-toradex

MENDER_FEATURES_ENABLE:append = " mender-uboot mender-image-sd"
MENDER_FEATURES_DISABLE:append = " mender-grub mender-image-uefi"
IMAGE_CLASSES += "image_type_mender_tezi"
IMAGE_FSTYPES:append = " mender_tezi"
IMAGE_FSTYPES:remove = " teziimg"
IMAGE_BOOT_FILES:remove = "zImage ${KERNEL_DEVICETREE} overlays.txt overlays/*;overlays/"
MENDER_BOOT_PART_SIZE_MB:verdin-imx8mm = "32"
OFFSET_SPL_PAYLOAD:verdin-imx8mm = ""
KERNEL_DEVICETREE:verdin-imx8mm = "freescale/imx8mm-verdin-wifi-dahlia.dtb"
MENDER_UBOOT_POST_SETUP_COMMANDS:append = " ; setenv tdxargs \${tdxargs} \${bootargs}; "
MENDER_UBOOT_POST_SETUP_COMMANDS:append = " ; setenv overlays_file /boot/overlays.txt ; setenv overlays_prefix boot/overlays/ "
TORADEX_BSP_VERSION = "toradex-bsp-6.2.0"
MENDER_STORAGE_TOTAL_SIZE_MB = "3072"

MENDER_ARTIFACT_NAME ?= "release-1"
```

## conf/distro/include/torizon-os-updater-rauc.inc
```bitbake
require conf/distro/include/torizon-os-nonostree.inc

PREFERRED_RPROVIDER_u-boot-default-env = "u-boot-toradex"

DISTRO_FEATURES += "rauc"
IMAGE_CLASSES += "image_types_rauc_tezi"
IMAGE_INSTALL:append = " rauc rauc-grow-data-part casync "
IMAGE_FSTYPES:append = " rauc_tezi "
IMAGE_FSTYPES:remove = " teziimg"
WKS_FILE = "sdimage-dual-toradex.wks.in"
OFFSET_SPL_PAYLOAD:verdin-imx8mm = ""
KERNEL_DEVICETREE:verdin-imx8mm = "freescale/imx8mm-verdin-wifi-dahlia.dtb"

RAUC_KEYRING_FILE = "/work/dmoseley/local/rauc-example-ca/ca.cert.pem"
RAUC_KEY_FILE = "/work/dmoseley/local/rauc-example-ca/private/development-1.key.pem"
RAUC_CERT_FILE = "/work/dmoseley/local/rauc-example-ca/development-1.cert.pem"
RAUC_SLOT_rootfs = "torizon-core-lite"
RAUC_SLOT_rootfs[adaptive] = "block-hash-index"
RAUC_BUNDLE_FORMAT = "verity"
RAUC_CASYNC_BUNDLE = "1"

ROOTFS_POSTPROCESS_COMMAND:append = " toradex_rauc_update_boot;"
toradex_rauc_update_boot() {
    # Copy files intended for the boot partition into the /boot directory of
    # the root partition.  We will modify the UBoot environment to load them
    # from there.  I feel like there is a cleaner way to do this but cannot
    # find it at the moment.
    # This should probably work using IMAGE_BOOT_FILES rather than hardcoding
    # but this is enough for my benchmarking needs
    cp ${DEPLOY_DIR_IMAGE}/overlays.txt ${IMAGE_ROOTFS}/boot/overlays.txt
    cp -R ${DEPLOY_DIR_IMAGE}/overlays/ ${IMAGE_ROOTFS}/boot/overlays
    cp ${DEPLOY_DIR_IMAGE}/${KERNEL_IMAGETYPE} ${IMAGE_ROOTFS}/boot/
    cp ${DEPLOY_DIR_IMAGE}/$(basename ${KERNEL_DEVICETREE}) ${IMAGE_ROOTFS}/boot/
    cp ${DEPLOY_DIR_IMAGE}/boot.scr-${MACHINE} ${IMAGE_ROOTFS}/boot/boot.scr
}
```

## conf/distro/include/torizon-os-updater-swupdate.inc
```bitbake
require conf/distro/include/torizon-os-nonostree.inc

IMAGE_CLASSES += "image_types_zchunk image_types_swupdate_tezi"
IMAGE_INSTALL:append = " swupdate swupdate-www swupdate-progress libubootenv-bin "
IMAGE_FSTYPES:append = " ext4.gz ext4.zck ext4.zck.zckheader swupdate_tezi "
IMAGE_FSTYPES:remove = " teziimg"
WKS_FILE:verdin-imx8mm = "ts-verdin-imx8mm.wks"
OFFSET_SPL_PAYLOAD:verdin-imx8mm = ""
KERNEL_DEVICETREE:verdin-imx8mm = "freescale/imx8mm-verdin-wifi-dahlia.dtb"

ROOTFS_POSTPROCESS_COMMAND:append = " toradex_swupdate_update_boot;"
toradex_swupdate_update_boot() {
    # Copy files intended for the boot partition into the /boot directory of
    # the root partition.  We will modify the UBoot environment to load them
    # from there.  I feel like there is a cleaner way to do this but cannot
    # find it at the moment.
    # This should probably work using IMAGE_BOOT_FILES rather than hardcoding
    # but this is enough for my benchmarking needs
    cp ${DEPLOY_DIR_IMAGE}/overlays.txt ${IMAGE_ROOTFS}/boot/overlays.txt
    cp -R ${DEPLOY_DIR_IMAGE}/overlays/ ${IMAGE_ROOTFS}/boot/overlays
    cp ${DEPLOY_DIR_IMAGE}/${KERNEL_IMAGETYPE} ${IMAGE_ROOTFS}/boot/
    cp ${DEPLOY_DIR_IMAGE}/$(basename ${KERNEL_DEVICETREE}) ${IMAGE_ROOTFS}/boot/
    cp ${DEPLOY_DIR_IMAGE}/boot.scr-${MACHINE} ${IMAGE_ROOTFS}/boot/boot.scr
}
```

## conf/distro/torizon.conf
```bitbake
require conf/distro/include/torizon.inc

DISTRO = "torizon"
DISTRO_NAME = "TorizonCore"

DISTRO_FLAVOUR:experimental = " (EXPERIMENTAL)"
```
